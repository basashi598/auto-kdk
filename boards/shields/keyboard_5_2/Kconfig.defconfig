## boards/shields/keyboard_5_2/Kconfig.defconfig
```kconfig
if SHIELD_KEYBOARD_5_2_LEFT
config ZMK_KEYBOARD_NAME
    default "keyboard_5_2"
config ZMK_SPLIT_ROLE_CENTRAL
    default y
endif

if SHIELD_KEYBOARD_5_2_LEFT || SHIELD_KEYBOARD_5_2_RIGHT
config ZMK_SPLIT
    default y
endif
```
